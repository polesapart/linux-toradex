/dts-v1/;
/plugin/;

/ {
	compatible = "toradex";
	fragment@0 {
		target-path = "/panel-dpi";
		__overlay__ {
			width-mm = <154>;
			height-mm = <86>;
			panel-timing {
				hactive = <800>;
				vactive = <480>;
				clock-frequency = <33260000>;
				hsync-len = <128>;
				vsync-len = <2>;
				hfront-porch = <40>;
				hback-porch = <88>;
				vfront-porch = <10>;
				vback-porch = <33>;
			};
		};
	};

	fragment@1 {
		target-path="/disp0";
		__overlay__ {
		status="okay";
		};
	};
};
