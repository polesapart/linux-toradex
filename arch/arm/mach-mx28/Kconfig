## drivers/net/wireless/digiPiper/Kconfig
```kconfig
config DIGI_PIPER_WIFI
	bool "Digi Piper Wifi support"
	depends on MAC80211 && WLAN_80211 && I2C && (MACH_CCW9P9215JS || MACH_CCW9M2443JS)
	---help---
	  This driver is for the Piper 802.11 MAC by Digi.  This MAC is
	  supported on the Digi ConnectCore Wi-9P 9215 and Digi ConnectCore Wi-9M 2443
	  embedded modules.

config PIPER_STATUS_LED
	bool "Enable wifi status led on development board"
	depends on DIGI_PIPER_WIFI && MACH_CCW9M2443JS
	default y
	help
	  ConnectCore Wi-9M 2443 does not provide any LED in the module,
	  so use one of the LED's in the development board.

config PIPER_STATUS_LED_GPIO
	int "gpio for wifi status led (0-144)"
	range 0 144
	depends on PIPER_STATUS_LED
	default "141"
	help
	  Set gpio for Wifi status LED on development board.

	  Default: User LED 1 (LE5)
```

## drivers/pmic/Kconfig
```kconfig
menu "Power Management IC's"

config PMIC
	tristate "Power Management IC support"

config PMIC_DEBUG
	bool "PMIC debug support"
	depends on PMIC
	help
	  Say yes here to enable debugging support in the PMIC framework
	  and individual PMIC drivers.

config PMIC_WM8350
	tristate "WOLFSON WM8350 support"
	help
	  If you say yes here you get support for the
	  Wolfon WM8350 PMIC chip.

	  This driver can also be built as a module. If so, the module
	  will be called pmic-wm8350.

menu "WM8350 Config Mode"
depends on PMIC_WM8350

choice
	prompt "WM8350 Configuration Mode"
	default PMIC_WM8350_MODE_0

config PMIC_WM8350_MODE_0
	bool "Mode 0"

config PMIC_WM8350_MODE_1
	bool "Mode 1"

config PMIC_WM8350_MODE_2
	bool "Mode 2"

config PMIC_WM8350_MODE_3
	bool "Mode 3"

endchoice

endmenu

endmenu
```

## drivers/pwm/Kconfig
```kconfig
#
# PWM infrastructure and devices
#

menuconfig GENERIC_PWM
	tristate "PWM Support"
	help
	  This enables PWM support through the generic PWM library.
	  If unsure, say N.

if GENERIC_PWM

config ATMEL_PWM
	tristate "Atmel AT32/AT91 PWM support"
	depends on AVR32 || ARCH_AT91
	help
	  This option enables device driver support for the PWMC
	  peripheral channels found on certain Atmel processors.
	  Pulse Width Modulation is used many for purposes, including
	  software controlled power-efficent backlights on LCD
	  displays, motor control, and waveform generation.  If
	  unsure, say N.

config NS921X_PWM
	tristate "Digi NS921X PWM support"
	depends on PROCESSOR_NS9215 && !CC9P9215JS_SERIAL_PORTA && !CC9P9215JS_SPI && !CC9P9215JS_SERIAL_PORTC_CTSRTSRXTX && !CC9P9215JS_SERIAL_PORTC_FULL
	help
	  This option enables device driver support for the PWMC
	  peripheral channels found on certain NetSilicon processors.
	  Pulse Width Modulation is used many for purposes, including
	  software controlled power-efficent backlights on LCD
	  displays, motor control, and waveform generation.  If
	  unsure, say N.

endif
```

## drivers/regulator/Kconfig
```kconfig
menu "Voltage and Current regulators"

config REGULATOR_API
	bool

config REGULATOR
	tristate "Voltage and Current Regulator Support"
	depends on EXPERIMENTAL
	select REGULATOR_API
	default n
	help
	  Generic Voltage and Current Regulator support.

config REGULATOR_DEBUG
	bool "Regulator debug support"
	depends on REGULATOR
	help
	  Say yes here to enable debugging support.

config REGULATOR_MC13783
    tristate "MC13783 Regulator Support"
        depends on REGULATOR
        depends on MXC_PMIC_MC13783
endmenu
```

## drivers/video/mxc/Kconfig
```kconfig
config FB_MXC
	tristate "MXC Framebuffer support"
	depends on FB && (MXC_IPU || ARCH_MX21 || ARCH_MX27)
	select FB_CFB_FILLRECT
	select FB_CFB_COPYAREA
	select FB_CFB_IMAGEBLIT
	default y
	help
	  This is a framebuffer device for the MXC LCD Controller.
	  See <http://www.linux-fbdev.org/> for information on framebuffer
	  devices.

	  If you plan to use the LCD display with your MXC system, say
	  Y here.

config FB_MXC_SYNC_PANEL
	depends on FB_MXC
	tristate "Synchronous Panel Framebuffer"
	default y

config FB_MXC_EPSON_VGA_SYNC_PANEL
	depends on FB_MXC_SYNC_PANEL
	tristate "Epson VGA Panel"
	default n

config FB_MXC_TVOUT
	bool "FS453 TV Out Encoder"
	depends on FB_MXC_SYNC_PANEL

config FB_MXC_TVOUT_CH7024
	tristate "CH7024 TV Out Encoder"
	depends on FB_MXC_SYNC_PANEL

config FB_MXC_LOW_PWR_DISPLAY
	bool "Low Power Display Refresh Mode"
	depends on FB_MXC_SYNC_PANEL && MXC_FB_IRAM
	default y

config FB_MXC_INTERNAL_MEM
	bool "Framebuffer in Internal RAM"
	depends on FB_MXC_SYNC_PANEL && MXC_FB_IRAM
	default y

config FB_MXC_ASYNC_PANEL
	depends on FB_MXC
	bool "Asynchronous Panels"
	default n

menu "Asynchronous Panel Type"
	depends on FB_MXC_ASYNC_PANEL && FB_MXC

config FB_MXC_EPSON_PANEL
    depends on FB_MXC_ASYNC_PANEL
	default n
	bool "Epson 176x220 Panel"

if MACH_I30030ADS
config FB_MXC_EPSON_QVGA_PANEL
    depends on FB_MXC_ASYNC_PANEL
	default y
	bool "Epson 240x320 Panel"
endif

if (MACH_MXC30030ADS || MACH_MXC30031ADS)
config FB_MXC_TOSHIBA_QVGA_PANEL
    depends on FB_MXC_ASYNC_PANEL
	bool "Toshiba 240x320 Panel"

config FB_MXC_SHARP_128_PANEL
    depends on FB_MXC_ASYNC_PANEL
	bool "Sharp 128x128 Panel"
endif

endmenu

choice
	prompt "Async Panel Interface Type"
	depends on FB_MXC_ASYNC_PANEL && FB_MXC
	default FB_MXC_ASYNC_PANEL_IFC_16_BIT

config FB_MXC_ASYNC_PANEL_IFC_8_BIT
	bool "8-bit Parallel Bus Interface"

config FB_MXC_ASYNC_PANEL_IFC_16_BIT
	bool "16-bit Parallel Bus Interface"

config FB_MXC_ASYNC_PANEL_IFC_SERIAL
	bool "Serial Bus Interface"

endchoice
```

## sound/soc/imx/Kconfig
```kconfig
config SND_MXC_SOC
 tristate "SoC Audio for the Freescale i.MX CPU"
 depends on ARCH_MXC && SND
 select SND_PCM
 help
   Say Y or M if you want to add support for codecs attached to
   the MXC I2S or SSP interface. You will also need
   to select the audio interfaces to support below.

config SND_MXC_SOC_SSI
 tristate

config SND_MXC_SOC_IRAM
 bool "Locate Audio DMA playback buffers in IRAM"
 help 
   Say Y if you don't want Audio playback buffers in external ram
 
config SND_SOC_IMX_3STACK_WM8350
 tristate "SoC Audio support for IMX - WM8350"
 select SND_MXC_SOC_SSI
 select SND_SOC_WM8350
 select REGULATOR_WM8350
 help
   Say Y if you want to add support for SoC audio on IMX 3STACK
   with the WM8350.
```
