## arch/arm/mach-mx51/Kconfig
```kconfig
menu "MX51 Options"
	depends on ARCH_MX51

config FORCE_MAX_ZONEORDER
    int "MAX_ORDER"
    default "13"

config MX51_OPTIONS
	bool
	default y
	select CPU_V7
	select USB_ARCH_HAS_EHCI
	select MXC_TZIC

config MACH_MX51_3DS
	bool "Support MX51 3-Stack platforms"
	default y
	help
	  Include support for MX51 3-Stack platform. This includes specific
	  configurations for the board and its peripherals.

config MACH_MX51_BABBAGE
	bool "Support MX51 BABBAGE platforms"
	help
	  Include support for MX51 Babbage platform. This includes specific
	  configurations for the board and its peripherals.

config MACH_CCWMX51JS
	bool "Support for the ConnectCore Wi-MX51 module, on the JSK base board"
	help
	  Include support for the Digi ConnectCore Wi-MX51 Embedded Module, on the
	  JumpStart Kit base board. This includes specific configurations for the
	  peripherals on that base board.

config MACH_CCMX51JS
	bool "Support for the ConnectCore MX51 module, on the JSK base board"
	help
	  Include support for the Digi ConnectCore MX51 Embedded Module, on the
	  JumpStart Kit base board. This includes specific configurations for the
	  peripherals on that base board.

config MACH_CCWMX51
	bool "Support for the ConnectCore Wi-MX51 module"
	help
	  Include support for the Digi ConnectCore Wi-MX51 Embedded Module, on a
	  custom board. The machine file should be modified to include support for
	  the interfaces available in that board.

config MACH_CCMX51
	bool "Support for the ConnectCore MX51 module"
	help
	  Include support for the Digi ConnectCore Wi-MX51 Embedded Module, on a
	  custom board. The machine file should be modified to include support for
	  the interfaces available in that board.

config MXC_SDMA_API
        bool "Use SDMA API"
        default y
        help
           This selects the Freescale MXC SDMA API.
           If unsure, say N.

config ARCH_MXC_HAS_NFC_V3
        bool "MXC NFC Hardware Version 3"
        depends on ARCH_MX51
        default y
        help
           This selects the Freescale MXC Nand Flash Controller Hardware Version 3
           If unsure, say N.

config ARCH_MXC_HAS_NFC_V3_2
        bool "MXC NFC Hardware Version 3.2"
        depends on ARCH_MXC_HAS_NFC_V3
        default y
        help
           This selects the Freescale MXC Nand Flash Controller Hardware Version 3.2
           If unsure, say N.

menu "SDMA options"
        depends on MXC_SDMA_API

config SDMA_IRAM
        bool "Use Internal RAM for SDMA transfer"
        default n
	help
           Support Internal RAM as SDMA buffer or control structures

config SDMA_IRAM_SIZE
        hex "Reserved bytes of IRAM for SDMA (0x800-0x1000)"
        range 0x800 0x1000
        depends on SDMA_IRAM
        default "0x1000"
        help
           Set the size of IRAM for SDMA. It must be a multiple of 512bytes.
endmenu

menu "I2C Options"

config I2C_MXC_SELECT1
	bool "Enable I2C1 module"
	default y
	depends on I2C_MXC
	help
	  Enable MX51 I2C1 module.

config I2C_MXC_SELECT2
	bool "Enable I2C2 module"
	default n
	depends on I2C_MXC
	help
	  Enable MX51 I2C2 module.

config I2C_MXC_SELECT3
	bool "Enable I2C3 module"
	default n
	depends on I2C_MXC
	help
	  Enable MX51 I2C3 module.

endmenu

menu "Serial Port Options"
config UART1_ENABLED
	bool "Enable UART1"
	default y
	depends on SERIAL_MXC
	help
	  Enable the MX51 UART1 interface

config UART2_ENABLED
	bool "Enable UART2"
	default y
	depends on SERIAL_MXC
	help
	  Enable the MX51 UART2 interface

config UART3_ENABLED
	bool "Enable UART3"
	default y
	depends on SERIAL_MXC
	help
	  Enable the MX51 UART3 interface
endmenu

endmenu
```

## arch/arm/mach-s3c2443/Kconfig
```kconfig
# arch/arm/mach-s3c2443/Kconfig
#
# Copyright 2007 Simtec Electronics
#
# Licensed under GPLv2

config CPU_S3C2443
	bool
	depends on ARCH_S3C2410
	select S3C2443_DMA if S3C2410_DMA
	select CPU_LLSERIAL_S3C2440
	help
	  Support for the S3C2443 SoC from the S3C24XX line

config S3C2443_DMA
	bool
	depends on CPU_S3C2443
	help
	  Internal config node for S3C2443 DMA support

menu "S3C2443 Machines"

config MACH_SMDK2443
	bool "SMDK2443"
	select CPU_S3C2443
	select MACH_SMDK
	help
	  Say Y here if you are using an SMDK2443

config MACH_CC9M2443JS
        bool "ConnectCore 9M 2443 on a JSCC9M2443 Devboard"
        select CPU_S3C2443
	select MACH_CC9M2443JS_PM if PM
        help
          Say Y here if you are using the ConnectCore 9M 2443 module
          on a JSCC9M2443 Development Board

config MACH_CC9M2443JS_GPIOLIB
        bool "Enables the machine's GPIO-Lib"
        depends on MACH_CC9M2443JS
        help
          Say Y to enable the GPIO-Lib support for the ConnectCore 9M 2443 module
          on a JSCC9M2443 Development Board

config MACH_CC9M2443JS_PM
	bool
	depends on MACH_CC9M2443JS && PM
	help
	  Internal config for the Power Management support on the CC9M2443JS

config MACH_CC9M2443JS_PM_EXTIRQ_226
	bool "Enable GPIO 226 as wakeup source"
	depends on MACH_CC9M2443JS_PM
	help
	  Enable the selected GPIO as external wakeup-IRQ

config MACH_CC9M2443JS_PM_EXTIRQ_232
	bool "Enable GPIO 232 as wakeup source"
	depends on MACH_CC9M2443JS_PM
	help
	  Enable the selected GPIO as external wakeup-IRQ
  	  
source "arch/arm/mach-s3c2443/displays/Kconfig"

endmenu
```

## arch/arm/plat-mxc/Kconfig
```kconfig
if ARCH_MXC

menu "Freescale MXC Implementations"

choice
	prompt "MXC/iMX System Type"
	default 0

config ARCH_MXC91321
	bool "MXC91321-based"
	select CPU_V6
	select CACHE_L2X0
	select MXC_DSP_BRINGUP
	select ARCH_HAS_EVTMON

config ARCH_MX37
    bool "MX37-based"
	select CPU_V6
	select CACHE_L2X0
	#select USB_ARCH_HAS_EHCI
	select ARCH_HAS_EVTMON
	select MXC_TZIC
    help
      This enables support for systems based on Freescale i.MX37

config ARCH_MX35
    bool "MX35-based"
        select CPU_V6
        select CACHE_L2X0
        #select USB_ARCH_HAS_EHCI
        select ARCH_HAS_EVTMON
    help
      This enables support for systems based on Freescale i.MX35

config ARCH_MX3
	bool "MX3-based"
	select CPU_V6
	select CACHE_L2X0
	select USB_ARCH_HAS_EHCI
	select ARCH_HAS_EVTMON
	help
	  This enables support for systems based on the Freescale i.MX31 and i.MX32

config ARCH_MX27
	bool "MX27-based"
	select CPU_ARM926T
	select MXC_EMMA
	select USB_ARCH_HAS_EHCI
	help
	  This enables support for systems based on the Freescale i.MX27

config ARCH_MX21
	bool "MX21-based"
	select CPU_ARM926T
	select MXC_EMMA
	help
	  This enables support for systems based on the Freescale i.MX21

endchoice

source "arch/arm/mach-mx27/Kconfig"

source "arch/arm/mach-mx21/Kconfig"

source "arch/arm/mach-mx3/Kconfig"

source "arch/arm/mach-mx35/Kconfig"

source "arch/arm/mach-mx37/Kconfig"

source "arch/arm/mach-mxc91321/Kconfig"






endmenu

config MXC_TZIC
	bool
	depends on ARCH_MXC

config MXC_DSP_BRINGUP
	bool
	depends on ARCH_MXC

config ARCH_HAS_EVTMON
	bool
	depends on ARCH_MXC

config MXC_EMMA
	bool
	depends on ARCH_MXC

config MXC_FB_IRAM
	bool
	depends on ARCH_MXC

config DMA_ZONE_SIZE
	int "DMA memory zone size"
	range 0 32
	default 24
	help
	  This is the size in MB for the DMA zone. The DMA zone is used for
	  dedicated memory for large contiguous video buffers

config ISP1504_MXC
	bool "ISP1504 transceiver support"
	depends on USB_ARCH_HAS_EHCI
	help
	  Support for the ISP1504 USB transceiver on MXC platforms.

choice
	prompt "Select serial USB transceiver"
	depends on USB_EHCI_ARC_OTGFS || USB_GADGET_ARC_OTGFS

config ISP1301_MXC
	bool "ISP1301 transceiver support"
	select I2C_MXC
	help
	  Support for the ISP1301 USB transceiver on MXC platforms.

config MC13783_MXC
	bool "MC13783 transceiver support"
	select SPI_MXC
	help
	  Support for the MC13783 USB transceiver on MXC platforms.
endchoice

choice
	prompt "Select serial USB mode"
	depends on ISP1301_MXC || MC13783_MXC

config MXC_USB_SB3
	bool "USB Single End Bidirection Mode"
	help
	  If you say yes to this option, the serial tranceiver is on SB3 mode

config MXC_USB_SU6
	bool "USB Single End Unidirection Mode"
	help
	  If you say yes to this option, the serial tranceiver is on SU6 mode

config MXC_USB_DB4
	bool "USB Differential Bidirection Mode"
	help
	  If you say yes to this option, the serial tranceiver is on DB4 mode

config MXC_USB_DU6
	bool "USB Differential Unidirection Mode"
	help
	  If you say yes to this option, the serial tranceiver is on DU6 mode

endchoice

endif
```
