## drivers/fims/Kconfig
```kconfig
#
# FIM devices configuration
#

menuconfig FIM_CORE
	tristate "FIM drivers support"
	depends on PROCESSOR_NS921X
        select FW_LOADER
        select HOTPLUG
	default n
	help
	  This option adds the support for the Flexible Interfaces Modules (FIM).
	  Currently only the NS921X processors are supporting the FIM-devices.
          The number of available FIMs is two for NS9215 and one for NS9210.

	  For installing the specific FIM-firmware, the FIM core driver depends on
	  Hotplug and the firmware-subsystem too.

##           If a FIM-driver is selected as loadable module, then is required
##           to have installed the user-space application 'mdev' (Busybox).


if FIM_CORE

config FIM_APPKIT_BOARD
	bool "Use FIM Application Kit hardware board"
	default y
	help
	  Enable this if you are going to use the FIM Application Kit hardware
	  board. This will configure the correct GPIOs to use with each FIM
	  and prevents you from selecting combinations of FIMs which are not
	  allowed in this hardware board (for example SDIO on both FIMs).

	  If using a custom board, you can disable this option.

config FIM_ZERO
	bool "FIM 0"
	depends on PROCESSOR_NS9210 || PROCESSOR_NS9215 && FIM_CORE=y
	help
	  Enables FIM 0

choice
	prompt "Choose FIM 0 driver"
	depends on FIM_ZERO
	help
	  Only one of the following drivers can run in the FIM. Please pick one.

config FIM_ZERO_SDIO_SELECTED
	bool "SDIO driver"
	depends on MMC && MMC_BLOCK
	depends on !(CME9210JS_SERIAL_PORTA_FULL || CME9210JS_SERIAL_PORTA_CTSRTSRXTX)
	select FIM_ZERO_SDIO
	help
	  Enables the FIM-SDIO driver.

          For testing the SDIO functionality is required to choose an additional
          SDIO-driver (GPS/UART) from the MMC-core.

config FIM_ZERO_SDIO_CD
	bool "Card Detect for SDIO on FIM 0"
	depends on FIM_ZERO && FIM_ZERO_SDIO_SELECTED && !FIM_APPKIT_BOARD
	help
	  If using a custom hardware board for using the FIM as SDIO function,
	  this item lets you specify whether the inteface will support the
	  Card Detect (CD) functionality using a GPIO.

config FIM_ZERO_SDIO_CD_GPIO
	int "GPIO to use for Card Detect on FIM 0"
	default 101
	depends on FIM_ZERO_SDIO_CD
	help
	  Specify the GPIO number to use for the SDIO Card Detect signal.

config FIM_ZERO_SDIO_CD_GPIO_FUNC
	int "Card Detect GPIO function"
	default 2
	depends on FIM_ZERO_SDIO_CD
	help
	  Specify the GPIO function to configure for the Card Detect GPIO.
	  If the GPIO is interrupt capable, write here the GPIO's interrupt
	  function number. Otherwise use 3 for standard GPIO function.
	  Please refer to the processor's Hardware Reference Manual for
	  the available GPIOs and functions.

config FIM_ZERO_SDIO_WP
	bool "Write Protect for SDIO on FIM 0"
	depends on FIM_ZERO && FIM_ZERO_SDIO_SELECTED && !FIM_APPKIT_BOARD
	help
	  If using a custom hardware board for using the FIM as SDIO function,
	  this item lets you specify whether the inteface will support the
	  Write Protect (WP) functionality using a GPIO.

config FIM_ZERO_SDIO_WP_GPIO
	int "GPIO to use for Write Protect on FIM 0"
	default 100
	depends on FIM_ZERO_SDIO_WP
	help
	  Specify the GPIO number to use for the SDIO Write Protect signal.

config FIM_ZERO_SERIAL_RXTX
	bool "Serial driver 2-wires (RX/TX)"
	depends on !(CME9210JS_SERIAL_PORTA_FULL || CME9210JS_SERIAL_PORTA_CTSRTSRXTX)
	select FIM_ZERO_SERIAL_SELECTED
	help
	  Enables the FIM-serial driver without the HW flow control (CTS and RTS
	  lines are not requested by the driver).

config FIM_ZERO_SERIAL_CTSRTS
	bool "Serial driver 4-wires (RX/TX/CTS/RTS)"
	depends on !(CME9210JS_SERIAL_PORTA || CME9210JS_SERIAL_PORTA_FULL || CME9210JS_SERIAL_PORTA_CTSRTSRXTX)
	select FIM_ZERO_SERIAL_SELECTED
	help
	  Enables the FIM-serial driver with HW flow control support.

config FIM_ZERO_CAN_SELECTED
	bool "CAN-bus driver"
	depends on CAN && CAN_DEV && (!MACH_CME9210 && !MACH_CME9210JS)
	select FIM_ZERO_CAN
	help
	  Enables the FIM-CAN bus driver.

config FIM_ZERO_W1_SELECTED
	bool "1-wire driver"
	depends on !(CME9210JS_SERIAL_PORTA_FULL || CME9210JS_SERIAL_PORTA_CTSRTSRXTX)
	select FIM_ZERO_W1
	select W1
	select W1_MASTER_GPIO
	help
	  Enables the 1-wire GPIO driver on the FIM-board. For the selection of the
	  connected slaves you need to enter the config menu of the 1-wire subsystem.

config FIM_ZERO_USB_SELECTED
        tristate "USB serial port driver"
        select FIM_ZERO_USB
	select SERIAL_CORE
        help
          Enables the USB serial port driver (low speed).

endchoice # FIM_ZERO

config FIM_ONE
	bool "FIM 1"
	depends on PROCESSOR_NS9210 || PROCESSOR_NS9215 && FIM_CORE=y
	help
	  Enables FIM 1

choice
	prompt "Choose FIM 1 driver"
	depends on FIM_ONE
	help
	  Only one of the following drivers can run in the FIM. Please pick one.

config FIM_ONE_SDIO_SELECTED
	bool "SDIO driver"
	depends on MMC && MMC_BLOCK
	depends on (!MACH_CME9210 && !MACH_CME9210JS)
	depends on !(FIM_ZERO_SDIO_SELECTED && FIM_APPKIT_BOARD)
	select FIM_ONE_SDIO
	help
	  Enables the FIM-SDIO serial driver.

          For testing the SDIO functionality is required to choose an additional
          SDIO-driver (GPS/UART) from the MMC-core.

config FIM_ONE_SDIO_CD
	bool "Card Detect for SDIO on FIM 1"
	depends on FIM_ONE && FIM_ONE_SDIO_SELECTED && !FIM_APPKIT_BOARD
	help
	  If using a custom hardware board for using the FIM as SDIO function,
	  this item lets you specify whether the inteface will support the
	  Card Detect (CD) functionality using a GPIO.

config FIM_ONE_SDIO_CD_GPIO
	int "GPIO to use for Card Detect on FIM 1"
	default 101
	depends on FIM_ONE_SDIO_CD
	help
	  Specify the GPIO number to use for the SDIO Card Detect signal.

config FIM_ONE_SDIO_CD_GPIO_FUNC
	int "Card Detect GPIO function"
	default 2
	depends on FIM_ONE_SDIO_CD
	help
	  Specify the GPIO function to configure for the Card Detect GPIO.
	  If the GPIO is interrupt capable, write here the GPIO's interrupt
	  function number. Otherwise use 3 for standard GPIO function.
	  Please refer to the processor's Hardware Reference Manual for
	  the available GPIOs and functions.

config FIM_ONE_SDIO_WP
	bool "Write Protect for SDIO on FIM 1"
	depends on FIM_ONE && FIM_ONE_SDIO_SELECTED && !FIM_APPKIT_BOARD
	help
	  If using a custom hardware board for using the FIM as SDIO function,
	  this item lets you specify whether the inteface will support the
	  Write Protect (WP) functionality using a GPIO.

config FIM_ONE_SDIO_WP_GPIO
	int "GPIO to use for Write Protect on FIM 1"
	default 100
	depends on FIM_ONE_SDIO_WP
	help
	  Specify the GPIO number to use for the SDIO Write Protect signal.

config FIM_ONE_SERIAL_RXTX
	bool "Serial driver 2-wires (RX/TX)"
	depends on !MACH_CME9210 && !MACH_CME9210JS
	select FIM_ONE_SERIAL_SELECTED
	help
	  Enables the FIM-serial driver without the HW flow control (CTS and RTS
          lines are not requested by the driver).

config FIM_ONE_SERIAL_CTSRTS
	bool "Serial driver 4-wires (RX/TX/CTS/RTS)"
	depends on !MACH_CME9210 && !MACH_CME9210JS
	select FIM_ONE_SERIAL_SELECTED
	help
	  Enables the FIM-serial driver with HW flow control support.

config FIM_ONE_CAN_SELECTED
	bool "CAN-bus driver"
	depends on CAN && CAN_DEV && !((MACH_CME9210 || MACH_CME9210JS) && (CME9210JS_SERIAL_PORTA_FULL || FIM_ZERO_SERIAL_SELECTED || FIM_ZERO_SDIO_SELECTED || I2C_NS9XXX))
	select FIM_ONE_CAN
	help
	  Enables the FIM-CAN bus driver.

config FIM_ONE_W1_SELECTED
	bool "1-wire driver"
	depends on !MACH_CME9210 && !MACH_CME9210JS && !FIM_ZERO_W1_SELECTED
	select FIM_ONE_W1
	select W1_MASTER_GPIO
	help
	  Enables the 1-wire GPIO driver on the FIM-board. For the selection of the
	  connected slaves you need to enter the config menu of the 1-wire subsystem.

config FIM_ONE_USB_SELECTED
        tristate "USB serial port driver"
        depends on !MACH_CME9210JS
        select FIM_ONE_USB
	select SERIAL_CORE
        help
          Enables the USB serial port driver (low speed).

endchoice # FIM_ONE

# -- Special configuration options for some FIM-drivers
config SERIAL_FIM_CONSOLE
        bool "Enable the FIM Serial Console"
        depends on FIM_ZERO_SERIAL_SELECTED || FIM_ONE_SERIAL_SELECTED
	select SERIAL_CORE_CONSOLE
        help
          Enables the console functionality on the FIM serial ports.

config FIM_MODULES
	bool "Enable FIM drivers as loadable modules"
	depends on !FIM_ZERO || !FIM_ONE
	help
	  This option allows to build the FIM drivers as loadable modules
	  rather than as built-in features.

if FIM_MODULES

# -- These are the options for enabling the FIM-drivers as loadable modules
config FIM_SDIO_MODULE
	bool "SDIO as loadable module"
	depends on MMC && MMC_BLOCK && !FIM_ZERO_SDIO_SELECTED && !FIM_ONE_SDIO_SELECTED && (!FIM_ZERO || !FIM_ONE)
	select FIM_ZERO_SDIO
	select FIM_ONE_SDIO if !(MACH_CME9210JS || MACH_CME9210)
	help
	  Enables the FIM SDIO as loadable module. The number of FIMs to be
	  handled by this driver can be passed with the module parameter 'fims',
	  where:
	  - fims=0 (FIM0)
	  - fims=1 (FIM1)
	  - fims=2 (FIM0 and FIM1)

	  If the FIM Application Kit hardware board is selected, SDIO can only
	  work with one of the FIMs, and the following GPIOs will be used:
	  - On cc9p9215js platform:
	  -- GPIO 101 for Card Detect
	  -- GPIO 100 for Write Protect
	  - On cme9210js platform:
	  -- GPIO 9 for Card Detect
	  -- GPIO 6 for Write Protect

	  If the FIM Application Kit hardware board is disabled because a custom
	  hardware board is to be used instead, then six new module parameters
	  are allowed to specify GPIOs for Card Detect and Write Protect
	  functionality for each FIM:
	  - 'cd0' for Card Detect on FIM0
	  - 'cd0_func' for Card Detect GPIO function on FIM0
	  - 'wp0' for Write Protect on FIM0
	  - 'cd1' for Card Detect on FIM1
	  - 'cd1_func' for Card Detect GPIO function on FIM1
	  - 'wp1' for Write Protect on FIM1
	  If a parameter is not specified, the corresponding functionality
	  won't be available for that FIM.
	  If Card Detect functionality is not available, it is assumed the card is
	  always plugged. If Write Protect functionality is not available, it is
	  assumed Write Protect is off.

config FIM_SERIAL_MODULE
	bool "Serial as loadable module"
	depends on !FIM_ZERO_SERIAL_SELECTED && !FIM_ONE_SERIAL_SELECTED && (!FIM_ZERO || !FIM_ONE)
	select FIM_ZERO_SERIAL
	select FIM_ONE_SERIAL if !(MACH_CME9210JS || MACH_CME9210)
	select SERIAL_CORE
	help
          Enables the FIM Serial loadable module. The number of FIMs to be
	  handled by this driver can be passed with the module parameter 'fims'

config FIM_CAN_MODULE
	bool "CAN as loadable module"
	depends on CAN && CAN_DEV && !FIM_ZERO_CAN_SELECTED && !FIM_ONE_CAN_SELECTED && (!FIM_ZERO || !FIM_ONE)
	select FIM_ZERO_CAN if !(MACH_CME9210JS || MACH_CME9210)
	select FIM_ONE_CAN
	help
          Enables the FIM CAN as loadable module. The number of FIMs to be
	  handled by this driver can be passed with the module parameter 'fims'

config FIM_USB_MODULE
        bool "USB serial port driver as loadable module"
        depends on SERIAL_CORE && !FIM_ZERO_USB_SELECTED && !FIM_ONE_USB_SELECTED
        select FIM_ZERO_USB
        select FIM_ONE_USB if !(MACH_CME9210JS || MACH_CME9210)
        help
          Enables the FIM USB Device Controller as loadable module.
          The number of FIMs to be handled by this driver can be passed with the
          module parameter 'fims'

endif # FIM_MODULES

# -- Variables for selection the platform devices
config FIM_ZERO_SDIO
	bool

config FIM_ONE_SDIO
	bool

config FIM_ZERO_SERIAL
	bool

config FIM_ZERO_SERIAL_SELECTED
        select FIM_ZERO_SERIAL
	select SERIAL_CORE
	bool

config FIM_ONE_SERIAL
	bool

config FIM_ONE_SERIAL_SELECTED
        select FIM_ONE_SERIAL
	select SERIAL_CORE
	bool

config FIM_ZERO_CAN
	bool

config FIM_ONE_CAN
	bool

config FIM_ZERO_W1
        bool

config FIM_ONE_W1
        bool

config FIM_ZERO_USB
        bool

config FIM_ONE_USB
        bool

endif # FIM_CORE
```

## drivers/media/video/mxc/output/Kconfig
```kconfig
config VIDEO_MXC_IPU_OUTPUT
	bool 
	depends on VIDEO_MXC_OUTPUT && MXC_IPU
	default y
	---help---
	  This is the video4linux2 driver for IPU post processing video output.

config VIDEO_MXC_EMMA_OUTPUT
	bool 
	depends on VIDEO_MXC_OUTPUT && MXC_EMMA && FB_MXC_SYNC_PANEL
	default y
	---help---
	  This is the video4linux2 driver for EMMA post processing video output.
```

## drivers/mxc/Kconfig
```kconfig
# drivers/video/mxc/Kconfig

if ARCH_MXC

menu "MXC support drivers"

source "drivers/mxc/ipu/Kconfig"
source "drivers/mxc/ssi/Kconfig"
source "drivers/mxc/dam/Kconfig"
source "drivers/mxc/pmic/Kconfig"
source "drivers/mxc/pm/Kconfig"
source "drivers/mxc/security/Kconfig"
source "drivers/mxc/hmp4e/Kconfig"

if ARCH_MX27
source "drivers/mxc/vpu/Kconfig"
endif

endmenu

endif
```

## drivers/mxc/pmic/Kconfig
```kconfig
#
# PMIC device driver configuration
#

menu "MXC PMIC support"

config MXC_SPI_PMIC_CORE
	tristate "PMIC Protocol support (SPI interface)"
	depends on ARCH_MXC && SPI_MXC
	default n
	---help---
	This is the PMIC core/protocol driver for the Freescale MXC application.
	SPI should be providing the interface between the PMIC and the MCU.
	You must select the SPI driver support to enable this option.

config MXC_I2C_MCU_PMIC_CORE
        tristate "MCU PMIC Protocol support (I2C interface)"
        depends on ARCH_MXC
        default n
        ---help---
        This is the PMIC core/protocol driver for the MX35 3DS MCU PMIC

config MXC_PMIC
	boolean
	default (MXC_SPI_PMIC_CORE || MXC_I2C_MCU_PMIC_CORE)

config MXC_PMIC_CHARDEV
	tristate "MXC PMIC device interface"
	depends on MXC_PMIC
	help
	  Say Y here to use "pmic" device files, found in the /dev directory
	  on the system.  They make it possible to have user-space programs
	  use or controll PMIC. Mainly its useful for notifying PMIC events
	  to user-space programs.

comment "MXC PMIC Client Drivers"
	depends on MXC_PMIC

config MXC_PMIC_MC13783
	tristate "MC13783 Client Drivers"
	depends on MXC_SPI_PMIC_CORE
	default n
	---help---
	This is the MXC MC13783(PMIC) client drivers support. It include
	ADC, Audio, Battery, Connectivity, Light, Power and RTC.

source "drivers/mxc/pmic/mc13783/Kconfig"

config MXC_PMIC_SC55112
	tristate "SC55112 Client Drivers"
	depends on MXC_SPI_PMIC_CORE && ARCH_MXC91131
	default n
	---help---
	This is the MXC MC13783(PMIC) client drivers support. It include
	ADC, Audio, Battery, Connectivity, Light, Power and RTC.

config MXC_PMIC_FIXARB
        bool "Use Arbitration Bit Workaround"
        depends on MXC_PMIC_SC55112
        default n
        ---help---
            Enable this option to include the code that will automatically
            toggle the sc55112 arbitration bits to allow register write
            access to the secondary processor. Note that this also requires
            a hardware modification to the RF Deck that connects the Sphinx
            card (with the sc55112 PMIC) to the MXC91131 EVB.

config MXC_PMIC_MC9SDZ60
        tristate "MC9sDZ60 Client Drivers"
        depends on MXC_I2C_MCU_PMIC_CORE
        depends on !ARCH_MXC91131
        default n
        ---help---
        This is the MXC MC9sDZ60(MCU) PMIC client drivers support.

source "drivers/mxc/pmic/mc9sdz60/Kconfig"

endmenu
```

## drivers/mxc/vpu/Kconfig
```kconfig
#
# Codec configuration
#

menu "H.264 VPU Codec support"

config MXC_VPU
	tristate "Support for mx27 H.264 VPU codec"
	help
	  The VPU codec device provides codec function for h.264/mpeg4/h.263

config MXC_VPU_DEBUG
	bool "MXC VPU debugging"
	depends on MXC_VPU != n
	help
	  This is an option for use by developers; most people should
	  say N here.  This enables MXC VPU driver debugging.

endmenu
```
